## proyectos/Apollo/buildRootConfig/PackageConfig/python-apollo/Config.in
```kconfig
config BR2_PACKAGE_PYTHON_APOLLO
        bool "python-apollo"
        help
          This is a comment that explains what apollo is.
```

## tareas/vgarcia/20161007-paquete/Config.in
```kconfig
config BR2_PACKAGE_MIPAQUETE
	bool "mipaquete"
	help
	  Mi paquete en buildroot.
```
